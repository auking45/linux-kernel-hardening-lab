## configs/base/x86_64_defconfig
```kconfig
# Minimal baseline defconfig for x86_64 QEMU fast boot
CONFIG_64BIT=y
CONFIG_X86_64=y
CONFIG_SMP=y
CONFIG_NR_CPUS=4

# Core Kernel & Executables
CONFIG_BINFMT_ELF=y
CONFIG_BINFMT_SCRIPT=y
CONFIG_PRINTK=y
CONFIG_PRINTK_TIME=y
CONFIG_BUG=y

# Initramfs & Compression
CONFIG_BLK_DEV_INITRD=y
CONFIG_RD_GZIP=y

# Devtmpfs & Virtual Filesystems
CONFIG_DEVTMPFS=y
CONFIG_DEVTMPFS_MOUNT=y
CONFIG_PROC_FS=y
CONFIG_SYSFS=y
CONFIG_TMPFS=y
CONFIG_DEBUG_FS=y

# Serial Console
CONFIG_SERIAL_8250=y
CONFIG_SERIAL_8250_CONSOLE=y
CONFIG_TTY=y

# QEMU / KVM essentials
CONFIG_KVM_GUEST=y
CONFIG_PARAVIRT=y
CONFIG_PCI=y

# Testing & Verification Tools
CONFIG_LKDTM=y
CONFIG_CRASH_DUMP=n
CONFIG_PANIC_TIMEOUT=1
```
